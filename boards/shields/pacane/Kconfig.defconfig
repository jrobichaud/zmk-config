## boards/shields/pacane/Kconfig.defconfig
```kconfig
if SHIELD_PACANE_LEFT

config ZMK_KEYBOARD_NAME
    default "Pacane"

config ZMK_SPLIT_ROLE_CENTRAL
    default y

endif

if SHIELD_PACANE_LEFT || SHIELD_PACANE_RIGHT

config ZMK_SPLIT
    default y

endif
```

## boards/shields/pacane/Kconfig.shield
```kconfig
config SHIELD_PACANE_LEFT
    def_bool $(shields_list_contains,pacane_left)

config SHIELD_PACANE_RIGHT
    def_bool $(shields_list_contains,pacane_right)
```

## boards/shields/pacane_macro/Kconfig.defconfig
```kconfig
if SHIELD_PACANE_MACRO

config ZMK_KEYBOARD_NAME
    default "Pacane Macro"
endif
```

## boards/shields/pacane_macro/Kconfig.shield
```kconfig
config SHIELD_PACANE_MACRO
    def_bool $(shields_list_contains,pacane_macro)

config SHIELD_PACANE_MACRO_DONGLE
    def_bool $(shields_list_contains,pacane_macro_dongle)
```
