#define HM_TAPPING_TERM 280
#define HM_TAPPING_TERM_FAST 200

/ {

  behaviors {

    // Positional Homerow mods
    // Homerow mods that prevent accidental activations when rolling keys,
    // such as when typing `st` or `ne` on colemak-dh layouts or `as` on
    // qwerty.
    //
    // Works by only allowing a mod to activate within tapping-term if
    // it's on the opposite side of the keyboard or on the same side thumb
    // keys.

    // Further optimization using urob's timerless homerow mods method:
    // https://github.com/urob/zmk-config#timeless-homerow-mods
    hml: homerow_mods_left {
      compatible = "zmk,behavior-hold-tap";
      label = "HOMEROW_MODS_LEFT";
    };

    hmr: homerow_mods_right {
      compatible = "zmk,behavior-hold-tap";
      label = "HOMEROW_MODS_RIGHT";
    };
  };
};
